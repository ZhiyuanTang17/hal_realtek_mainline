## bee/drivers/adc/Kconfig
```kconfig
# Copyright (c) 2026, Realtek Semiconductor Corporation
# SPDX-License-Identifier: Apache-2.0

config REALTEK_BEE_ADC
	bool "Realtek Bee ADC driver"
	default n
	help
	  This option enables the ADC driver for Realtek Bee.
```

## bee/drivers/can/Kconfig
```kconfig
# Copyright (c) 2026, Realtek Semiconductor Corporation
# SPDX-License-Identifier: Apache-2.0

config REALTEK_BEE_CAN
	bool "Realtek Bee CAN driver"
	default n
	help
	  This option enables the CAN driver for Realtek Bee.
```

## bee/drivers/codec/Kconfig
```kconfig
# Copyright (c) 2026, Realtek Semiconductor Corporation
# SPDX-License-Identifier: Apache-2.0

config REALTEK_BEE_CODEC
	bool "Realtek Bee CODEC driver"
	default n
	help
	  This option enables the codec driver for Realtek Bee.
```

## bee/drivers/dma/Kconfig
```kconfig
# Copyright (c) 2026, Realtek Semiconductor Corporation
# SPDX-License-Identifier: Apache-2.0

config REALTEK_BEE_DMA
	bool "Realtek Bee DMA driver"
	default n
	help
	  This option enables the DMA driver for Realtek Bee.
```

## bee/drivers/gpio/Kconfig
```kconfig
# Copyright (c) 2026, Realtek Semiconductor Corporation
# SPDX-License-Identifier: Apache-2.0

config REALTEK_BEE_GPIO
	bool "Realtek Bee GPIO driver"
	default n
	help
	  This option enables the GPIO driver for Realtek Bee.
```

## bee/drivers/i2c/Kconfig
```kconfig
# Copyright (c) 2026, Realtek Semiconductor Corporation
# SPDX-License-Identifier: Apache-2.0

config REALTEK_BEE_I2C
	bool "Realtek Bee I2C driver"
	default n
	help
	  This option enables the I2C driver for Realtek Bee.
```

## bee/drivers/i2s/Kconfig
```kconfig
# Copyright (c) 2026, Realtek Semiconductor Corporation
# SPDX-License-Identifier: Apache-2.0

config REALTEK_BEE_I2S
	bool "Realtek Bee I2S driver"
	default n
	help
	  This option enables the I2S driver for Realtek Bee.
```

## bee/drivers/ir/Kconfig
```kconfig
# Copyright (c) 2026, Realtek Semiconductor Corporation
# SPDX-License-Identifier: Apache-2.0

config REALTEK_BEE_IR
	bool "Realtek Bee IR driver"
	default n
	help
	  This option enables the IR driver for Realtek Bee.
```

## bee/drivers/irq/Kconfig
```kconfig
# Copyright (c) 2026, Realtek Semiconductor Corporation
# SPDX-License-Identifier: Apache-2.0

config REALTEK_BEE_NVIC
	bool "Realtek Bee IRQ driver"
	default n
	help
	  This option enables the IRQ driver for Realtek Bee.
```

## bee/drivers/pinmux/Kconfig
```kconfig
# Copyright (c) 2026, Realtek Semiconductor Corporation
# SPDX-License-Identifier: Apache-2.0

config REALTEK_BEE_PINMUX
	bool "Realtek Bee PINMUX driver"
	default n
	help
	  This option enables the PINMUX driver for Realtek Bee.
```

## bee/drivers/pwm/Kconfig
```kconfig
# Copyright (c) 2026, Realtek Semiconductor Corporation
# SPDX-License-Identifier: Apache-2.0

config REALTEK_BEE_PWM
	bool "Realtek Bee PWM driver"
	default n
	help
	  This option enables the PWM driver for Realtek Bee.
```

## bee/drivers/qdec/Kconfig
```kconfig
# Copyright (c) 2026, Realtek Semiconductor Corporation
# SPDX-License-Identifier: Apache-2.0

config REALTEK_BEE_QDEC
	bool "Realtek Bee QDEC driver"
	default n
	help
	  This option enables the QDEC driver for Realtek Bee.

config REALTEK_BEE_AON_QDEC
	bool "Realtek Bee AON QDEC driver"
	default n
	help
	  This option enables the AON QDEC driver for Realtek Bee.

config REALTEK_BEE_LPQDEC
	bool "Realtek Bee LP QDEC driver"
	default n
	help
	  This option enables the LP QDEC driver for Realtek Bee.
```

## bee/drivers/rcc/Kconfig
```kconfig
# Copyright (c) 2026, Realtek Semiconductor Corporation
# SPDX-License-Identifier: Apache-2.0

config REALTEK_BEE_RCC
	bool "Realtek Bee RCC driver"
	default n
	help
	  This option enables the RCC driver for Realtek Bee.
```

## bee/drivers/rtc/Kconfig
```kconfig
# Copyright (c) 2026, Realtek Semiconductor Corporation
# SPDX-License-Identifier: Apache-2.0

config REALTEK_BEE_RTC
	bool "Realtek Bee RTC driver"
	default n
	help
	  This option enables the RTC driver for Realtek Bee.

config REALTEK_BEE_GRTC
	bool "Realtek Bee GRTC driver"
	default n
	help
	  This option enables the GRTC driver for Realtek Bee.
```

## bee/drivers/sdhc/Kconfig
```kconfig
# Copyright (c) 2026, Realtek Semiconductor Corporation
# SPDX-License-Identifier: Apache-2.0

config REALTEK_BEE_SDHC
	bool "Realtek Bee SDHC driver"
	default n
	help
	  This option enables the sdhc driver for Realtek Bee MCU.
```

## bee/drivers/spi/Kconfig
```kconfig
# Copyright (c) 2026, Realtek Semiconductor Corporation
# SPDX-License-Identifier: Apache-2.0

config REALTEK_BEE_SPI
	bool "Realtek Bee SPI driver"
	default n
	help
	  This option enables the spi driver for Realtek Bee.
```

## bee/drivers/timer/Kconfig
```kconfig
# Copyright (c) 2026, Realtek Semiconductor Corporation
# SPDX-License-Identifier: Apache-2.0

config REALTEK_BEE_TIMER
	bool "Realtek Bee TIMER driver"
	default n
	help
	  This option enables the timer driver for Realtek Bee.

config REALTEK_BEE_ENHTIMER
	bool "Realtek Bee ENHTIMER driver"
	default n
	help
	  This option enables the enhtimer driver for Realtek Bee.
```

## bee/drivers/uart/Kconfig
```kconfig
# Copyright (c) 2026, Realtek Semiconductor Corporation
# SPDX-License-Identifier: Apache-2.0

config REALTEK_BEE_UART
	bool "Realtek Bee UART driver"
	default n
	help
	  This option enables the UART driver for Realtek Bee.
```
